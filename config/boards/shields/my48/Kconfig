## config/boards/shields/my48/Kconfig.shield
```kconfig
config SHIELD_MY48
    bool "My 48 keyboard shield"
    depends on ARDUINO_PRO_MICRO || BOARD_NICE_NANO_V2 || BOARD_NICE_NANO
    select HAS_NICE_VIEW_DISPLAY if NICE_VIEW
    help
      Enable support for My 48 keyboard shield.
```

## dts/bindings/behaviors/zmk,behavior-legacy-bootloader.yaml
```yaml
# Copyright (c) 2026
# SPDX-License-Identifier: MIT

description: Legacy GPREGRET bootloader entry for Adafruit/Daxiong nRF52 bootloaders

compatible: "zmk,behavior-legacy-bootloader"

include: zero_param.yaml
```
